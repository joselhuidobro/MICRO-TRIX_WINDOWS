## esp-docker-jetson-encoder_motor_ui/sdkconfig.defaults
```kconfig
#
# SDK defaults for ESP32 + Arduino support
#

###############################################################################
# micro‑ROS – Wi‑Fi UDP
###############################################################################

CONFIG_ESP_WIFI_STATIC_RX_BUFFER_NUM=8
CONFIG_ESP_WIFI_DYNAMIC_RX_BUFFER_NUM=32
CONFIG_ESP_WIFI_SOFTAP_BEACON_MAX_LEN=752
CONFIG_LWIP_MAX_SOCKETS=10

# micro-ROS Configuration

# ─── micro‑ROS + UDP interno ───
CONFIG_MICROROS_ALLOW_CUSTOM_TRANSPORT=n
CONFIG_MICROROS_UDP_TRANSPORT=y
CONFIG_MICROROS_IPV4=y
CONFIG_MICROROS_DEFAULT_UDP_IP="192.168.0.203"
CONFIG_MICROROS_DEFAULT_UDP_PORT=9999

CONFIG_ESP_WIFI_STATIC_TX_BUFFER=y
CONFIG_ESP_WIFI_TX_BUFFER_TYPE=1
CONFIG_ESP_WIFI_STATIC_TX_BUFFER_NUM=16
CONFIG_ESP_WIFI_AMPDU_TX_ENABLED=y
CONFIG_ESP_WIFI_AMPDU_RX_ENABLED=y

# WiFi Configuration
CONFIG_ESP_WIFI_SSID="TU_SSID"
CONFIG_ESP_WIFI_PASSWORD="TU_PASS"
CONFIG_ESP_MAXIMUM_RETRY=5

CONFIG_MICRO_XRCE_DDS_CLIENT_CUSTOM=Y
CONFIG_MICRO_XRCE_DDS_UDP_TRANSPORT_MTU=1024
CONFIG_RMW_UXRCE_MAX_NODES=3
CONFIG_RMW_UXRCE_MAX_PUBLISHERS=5
CONFIG_RMW_UXRCE_MAX_SUBSCRIPTIONS=5
CONFIG_RMW_UXRCE_MAX_SERVICES=2
CONFIG_RMW_UXRCE_MAX_CLIENTS=2

# Target
CONFIG_IDF_TARGET="esp32"
CONFIG_IDF_TARGET_ESP32=y

# FreeRTOS
CONFIG_FREERTOS_HZ=1000
CONFIG_FREERTOS_ASSERT_ON_UNTESTED_FUNCTION=y
CONFIG_FREERTOS_CHECK_STACKOVERFLOW_CANARY=y
CONFIG_FREERTOS_IDLE_TASK_STACKSIZE=1536
CONFIG_FREERTOS_ISR_STACKSIZE=1536

# Bootloader log level
CONFIG_BOOTLOADER_LOG_LEVEL_INFO=y

# Logging
CONFIG_LOG_DEFAULT_LEVEL_INFO=y
CONFIG_LOG_COLORS=y
CONFIG_LOG_TIMESTAMP_SOURCE_RTOS=y

# Partition table
CONFIG_PARTITION_TABLE_CUSTOM=y
CONFIG_PARTITION_TABLE_CUSTOM_FILENAME="partitions.csv"
CONFIG_PARTITION_TABLE_CUSTOM_APP_BIN_OFFSET=0x10000
CONFIG_PARTITION_TABLE_SINGLE_APP=y
CONFIG_PARTITION_TABLE_TWO_OTA=y
CONFIG_PARTITION_TABLE_OFFSET=0x8000

# Flash options
CONFIG_ESPTOOLPY_FLASHMODE_DIO=y
CONFIG_ESPTOOLPY_FLASHFREQ_40M=y
CONFIG_ESPTOOLPY_FLASHSIZE_4MB=y
CONFIG_ESPTOOLPY_BEFORE="default_reset"
CONFIG_ESPTOOLPY_AFTER="hard_reset"
CONFIG_ESPTOOLPY_PORT="/dev/ttyUSB0"
CONFIG_ESPTOOLPY_MONITOR_BAUD_115200B=y

# Arduino component
CONFIG_ARDUINO_ESP32_GENERATE_VARIANTS=y
```
